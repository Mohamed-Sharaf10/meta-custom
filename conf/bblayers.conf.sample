## conf/bblayers.conf.sample
```bitbake
# POKY_BBLAYERS_CONF_VERSION is increased each time build/conf/bblayers.conf
# changes incompatibly
POKY_BBLAYERS_CONF_VERSION = "2"

BBPATH = "${TOPDIR}"
BBFILES ?= ""

BBLAYERS ?= " \
  /home/${USER}/yocto/poky/meta \
  /home/${USER}/yocto/poky/meta-poky \
  /home/${USER}/yocto/poky/meta-yocto-bsp \
  /home/${USER}/yocto/layers/meta-raspberrypi \
  /home/${USER}/yocto/layers/meta-custom \
  "
```
